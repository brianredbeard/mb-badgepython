## configs/monkeybadge_defconfig
```kconfig
CONFIG_ESPTOOLPY_FLASHSIZE_8MB=y
CONFIG_PARTITION_TABLE_CUSTOM=y
CONFIG_INFO_FIRMWARE_NAME="threebie"
CONFIG_INFO_HARDWARE_NAME="Monkeybadge"
CONFIG_MICROPY_FROZEN_MANIFEST="monkeybadge.py"
CONFIG_INFO_HARDWARE_WOEZEL_NAME="monkeybadge"
CONFIG_OTA_WEB_SERVER=""
CONFIG_OTA_WEB_PATH=""
CONFIG_OTA_WEB_VERSION_PATH=""
CONFIG_WOEZEL_WEB_SERVER=""
CONFIG_COMPILER_OPTIMIZATION_SIZE=y
CONFIG_BT_ENABLED=y
CONFIG_BT_NIMBLE_ENABLED=y
CONFIG_BT_NIMBLE_ACL_BUF_COUNT=12
# CONFIG_ETH_USE_SPI_ETHERNET is not set
CONFIG_HTTPD_WS_SUPPORT=y
CONFIG_ESP_IPC_TASK_STACK_SIZE=1024
CONFIG_ESP_PHY_MAX_WIFI_TX_POWER=15
CONFIG_PM_ENABLE=y
# CONFIG_ESP_TASK_WDT_CHECK_IDLE_TASK_CPU0 is not set
CONFIG_ESP32_WIFI_STATIC_TX_BUFFER=y
# CONFIG_ESP32_WIFI_IRAM_OPT is not set
# CONFIG_ESP32_WIFI_RX_IRAM_OPT is not set
# CONFIG_ESP32_WIFI_ENABLE_WPA3_SAE is not set
CONFIG_FATFS_LFN_HEAP=y
CONFIG_FMB_TIMER_PORT_ENABLED=y
CONFIG_FREERTOS_THREAD_LOCAL_STORAGE_POINTERS=2
CONFIG_FREERTOS_IDLE_TASK_STACKSIZE=2304
CONFIG_FREERTOS_ENABLE_STATIC_TASK_CLEAN_UP=y
CONFIG_HEAP_POISONING_LIGHT=y
CONFIG_HEAP_TRACING_STANDALONE=y
CONFIG_HEAP_TASK_TRACKING=y
CONFIG_LOG_DEFAULT_LEVEL_WARN=y
CONFIG_LWIP_PPP_SUPPORT=y
CONFIG_LWIP_PPP_PAP_SUPPORT=y
CONFIG_LWIP_PPP_CHAP_SUPPORT=y
CONFIG_VFS_SEMIHOSTFS_MAX_MOUNT_POINTS=2
CONFIG_WL_SECTOR_SIZE_512=y
CONFIG_WL_SECTOR_MODE_PERF=y
CONFIG_BUS_I2C0_ENABLE=y
CONFIG_PIN_NUM_I2C0_DATA=21
CONFIG_PIN_NUM_I2C0_CLK=22
CONFIG_I2C0_MASTER_FREQ_HZ=400000
CONFIG_BUS_I2C1_ENABLE=y
CONFIG_PIN_NUM_I2C1_DATA=4
CONFIG_PIN_NUM_I2C1_CLK=23
CONFIG_I2C1_MASTER_FREQ_HZ=400000
CONFIG_G_MATRIX_ENABLE=y
CONFIG_DRIVER_HEAPSPACE_ENABLE=y
CONFIG_MICROPY_PY_FRAMEBUF=y
CONFIG_MICROPY_PY_USE_BTREE=y
CONFIG_MICROPY_USE_WEBSOCKETS=y
CONFIG_MICROPY_USE_DISPLAY=y
CONFIG_MICROPY_USE_MDNS=y
CONFIG_MICROPY_USE_REQUESTS=y
# CONFIG_MICROPY_USE_OPUS is not set
```
